## main/Kconfig.projbuild
```kconfig
menu "ESP32-NES"

    config NES_AP_SSID_PREFIX
        string "SoftAP SSID prefix"
        default "NES"
        help
            The AP name is <prefix>-XXXX where XXXX is derived from the MAC.

    config NES_AP_PASSWORD
        string "SoftAP password (at least 8 characters)"
        default "nes12345"

    config NES_AP_CHANNEL
        int "SoftAP channel"
        range 1 13
        default 6

    config NES_WIFI_SSID
        string "Default home Wi-Fi SSID (optional, 2.4GHz)"
        default ""
        help
            If non-empty and no credentials were saved through the web page,
            the device joins this network at boot. Credentials entered on the
            provisioning page are stored in NVS and take precedence.

    config NES_WIFI_PASSWORD
        string "Default home Wi-Fi password"
        default ""

endmenu
```

## sdkconfig.defaults
```kconfig
# ---- Build ----
CONFIG_COMPILER_OPTIMIZATION_PERF=y
CONFIG_COMPILER_CXX_EXCEPTIONS=n
CONFIG_COMPILER_CXX_RTTI=n
CONFIG_COMPILER_WARN_WRITE_STRINGS=n
CONFIG_NEWLIB_NANO_FORMAT=y

# ---- Flash / partitions ----
CONFIG_ESPTOOLPY_FLASHSIZE_16MB=y
CONFIG_ESPTOOLPY_FLASHMODE_QIO=y
CONFIG_ESPTOOLPY_FLASHFREQ_80M=y
CONFIG_PARTITION_TABLE_CUSTOM=y
CONFIG_PARTITION_TABLE_CUSTOM_FILENAME="partitions.csv"
CONFIG_PARTITION_TABLE_OFFSET=0x8000

# ---- CPU ----
CONFIG_ESP_DEFAULT_CPU_FREQ_MHZ_240=y

# ---- RTOS ----
CONFIG_FREERTOS_HZ=1000
CONFIG_ESP_MAIN_TASK_STACK_SIZE=8192
CONFIG_ESP_SYSTEM_EVENT_TASK_STACK_SIZE=4096
CONFIG_ESP_TASK_WDT_TIMEOUT_S=10

# ---- HTTP / sockets ----
CONFIG_LWIP_MAX_SOCKETS=16
CONFIG_HTTPD_MAX_REQ_HDR_LEN=1024
CONFIG_HTTPD_MAX_URI_LEN=512

# ---- FATFS ----
CONFIG_FATFS_LFN_HEAP=y
CONFIG_FATFS_MAX_LFN=255

# ---- Bluetooth: NimBLE BLE HID host ----
CONFIG_BT_ENABLED=y
CONFIG_BT_NIMBLE_ENABLED=y
CONFIG_BT_NIMBLE_ROLE_CENTRAL=y
CONFIG_BT_NIMBLE_ROLE_OBSERVER=y
CONFIG_BT_NIMBLE_MAX_CONNECTIONS=1
CONFIG_BT_NIMBLE_NVS_PERSIST=y
CONFIG_BT_NIMBLE_SM_LEGACY=y
CONFIG_BT_NIMBLE_SM_SC=y
CONFIG_BT_NIMBLE_HOST_TASK_STACK_SIZE=5120

# ---- Wi-Fi / Bluetooth coexistence ----
CONFIG_ESP_COEX_SW_COEXIST_ENABLE=y
CONFIG_ESP_WIFI_SOFTAP_SUPPORT=y
CONFIG_BT_NIMBLE_HID_SERVICE=y
CONFIG_BT_NIMBLE_ROLE_PERIPHERAL=y
CONFIG_BT_NIMBLE_GATT_SERVER=y

# ---- Memory: keep internal RAM for NES ROMs ----
CONFIG_BT_NIMBLE_MEM_ALLOC_MODE_EXTERNAL=y
CONFIG_ESP_WIFI_STATIC_RX_BUFFER_NUM=3
CONFIG_ESP_WIFI_DYNAMIC_RX_BUFFER_NUM=8
CONFIG_ESP_WIFI_DYNAMIC_TX_BUFFER_NUM=8
CONFIG_ESP_WIFI_RX_BA_WIN=3
# Keep TCP/IP processing off core 1, where the NES hot loop runs.
CONFIG_LWIP_TCPIP_TASK_AFFINITY_CPU0=y
CONFIG_ESP_WIFI_IRAM_OPT=n
CONFIG_ESP_WIFI_RX_IRAM_OPT=n
CONFIG_LOG_MAXIMUM_LEVEL_DEBUG=y
CONFIG_HTTPD_WS_SUPPORT=y

# Larger TCP buffers for the tile/PCM WebSocket stream.
CONFIG_LWIP_TCP_SND_BUF_DEFAULT=16384
CONFIG_LWIP_TCP_WND_DEFAULT=8192
```

## sdkconfig.defaults.esp32s3
```kconfig
# ---- ESP32-S3: 8MB octal PSRAM @ 80MHz ----
CONFIG_SPIRAM=y
CONFIG_SPIRAM_MODE_OCT=y
CONFIG_SPIRAM_SPEED_80M=y
CONFIG_SPIRAM_BOOT_INIT=y
CONFIG_SPIRAM_USE_MALLOC=y
CONFIG_SPIRAM_MALLOC_ALWAYSINTERNAL=1024
CONFIG_SPIRAM_MALLOC_RESERVE_INTERNAL=65536
CONFIG_SPIRAM_ALLOW_BSS_SEG_EXTERNAL_MEMORY=y
CONFIG_SPIRAM_MEMTEST=n

# ---- Caches ----
CONFIG_ESP32S3_INSTRUCTION_CACHE_32KB=y
CONFIG_ESP32S3_DATA_CACHE_32KB=y
CONFIG_ESP32S3_DATA_CACHE_LINE_64B=y
```
